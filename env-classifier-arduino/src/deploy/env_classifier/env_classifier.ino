// Environmental State Classifier + Fan Control
//
// Reads the thermistor, photoresistor, and DHT11, classifies the current
// environmental state using a decision tree trained offline (see
// training/train.py) and exported to tree.h, then drives a fan via an
// NPN transistor based on the classified state. Displays the current
// state, fan status, and raw sensor readings on a 16x2 character LCD.
//
// IMPORTANT: tree.h is generated by train.py from your own collected
// data -- it is NOT included here as a real model. Copy the tree.h that
// train.py produces into this sketch folder before compiling.
//
// LCD wiring note: this uses the same parallel LCD wiring pattern as the
// Lane Dodger project (RS, E, D4-D7), and happens to land on the exact
// same UNO pins (D2-D7) -- that's fine since these are two separate
// physical builds, not running at the same time. The pin conflict that
// DOES matter is internal to THIS project: the DHT11 originally used D7
// in the data-collection sketch, which collides with the LCD's RS line
// here. That's why DHT_PIN is D8 in this file specifically.

#include <LiquidCrystal.h>
#include <DHT.h>
#include <string.h>
#include "tree.h"  // generated by training/train.py -- defines EnvClass and classify()

const uint8_t THERMISTOR_PIN = A0;
const uint8_t PHOTORESISTOR_PIN = A1;
const uint8_t DHT_PIN = 8;   // moved from D7 -- D7 is now the LCD's RS line
const uint8_t FAN_PIN = 9;   // drives the NPN transistor base (through a base resistor)

// LCD pins: RS, E, D4, D5, D6, D7 (LiquidCrystal constructor order)
const uint8_t LCD_RS = 7;
const uint8_t LCD_EN = 6;
const uint8_t LCD_D4 = 5;
const uint8_t LCD_D5 = 4;
const uint8_t LCD_D6 = 3;
const uint8_t LCD_D7 = 2;
LiquidCrystal lcd(LCD_RS, LCD_EN, LCD_D4, LCD_D5, LCD_D6, LCD_D7);

#define DHT_TYPE DHT11
DHT dht(DHT_PIN, DHT_TYPE);

const unsigned long SAMPLE_INTERVAL_MS = 1000;
unsigned long lastSampleMs = 0;

// The DHT11's read protocol is a single-wire, microsecond-timed exchange
// that briefly disables interrupts while it runs -- this is inherent to
// how the Adafruit DHT library talks to this specific sensor, not a bug
// in this sketch. The LiquidCrystal library ALSO depends on precise
// timing (pulsing the Enable line) to write correctly. When a DHT11
// read's interrupt-disabled window lands too close to an LCD write, the
// LCD can receive corrupted timing on its Enable pulses, which shows up
// as garbled characters on screen -- while Serial output, which has no
// equivalent timing sensitivity, keeps working perfectly. This is why
// the bug was invisible over Serial but visible on the LCD.
//
// Fix: read the DHT11 on its own, slower timer, separate from the main
// sensor-sample/LCD-render cycle. The DHT11 is documented as unreliable
// if polled faster than about once per second anyway, so this isn't a
// tradeoff -- it's a correction to a polling rate that was already
// faster than the sensor's own spec.
const unsigned long DHT_READ_INTERVAL_MS = 2500;
unsigned long lastDhtReadMs = 0;
float lastValidTemp = 25.0;
float lastValidHumidity = 50.0;

// Which classified states should turn the fan on. Decided here, once,
// rather than scattered through the logic below -- if you retrain with
// different class names you only need to update this one place.
bool shouldFanRun(EnvClass state) {
  return state == BRIGHT_WARM || state == DARK_WARM;
}

const char* classToString(EnvClass state) {
  switch (state) {
    case BRIGHT_WARM: return "bright_warm";
    case BRIGHT_COOL: return "bright_cool";
    case DARK_WARM:   return "dark_warm";
    case DARK_COOL:   return "dark_cool";
    default:          return "unknown";
  }
}

// Short form for the LCD specifically -- the full names above don't fit
// on a 16-character row alongside the fan status, so this is a separate,
// deliberately abbreviated label rather than truncating the full name
// (which would risk two different states looking identical if cut off
// at the same length, e.g. "bright_w" vs "bright_c" still differ, but
// it's needlessly fragile to rely on that).
const char* classToShortLabel(EnvClass state) {
  switch (state) {
    case BRIGHT_WARM: return "BR-WARM";
    case BRIGHT_COOL: return "BR-COOL";
    case DARK_WARM:   return "DK-WARM";
    case DARK_COOL:   return "DK-COOL";
    default:          return "UNKNOWN";
  }
}

// Renders both LCD rows for the current tick. Row 1: classified state +
// fan status. Row 2: raw thermistor, raw photoresistor, and DHT temp --
// humidity is deliberately left off row 2 to keep worst-case digit
// counts (1023 + 1023 + a 2-digit temp) safely within the 16-character
// width; see the README for that tradeoff. Full precision for all four
// values is still available over Serial.
void renderLCD(EnvClass state, bool fanOn, int thermistorRaw, int photoRaw, float temp) {
  lcd.setCursor(0, 0);
  char row1[17];
  snprintf(row1, sizeof(row1), "%-7s FAN:%s", classToShortLabel(state), fanOn ? "ON " : "OFF");
  lcd.print(row1);

  lcd.setCursor(0, 1);
  char row2[17];
  snprintf(row2, sizeof(row2), "T%d P%d %dC", thermistorRaw, photoRaw, (int)temp);
  // Pad with trailing spaces so a shorter new string fully overwrites a
  // longer previous one -- e.g. if thermistorRaw shrinks from 4 digits
  // to 3, lcd.print() alone won't blank the leftover character from the
  // previous frame.
  lcd.print(row2);
  for (int i = strlen(row2); i < 16; i++) {
    lcd.print(' ');
  }
}

void setup() {
  Serial.begin(9600);
  dht.begin();
  lcd.begin(16, 2);
  pinMode(FAN_PIN, OUTPUT);
  digitalWrite(FAN_PIN, LOW);

  lcd.setCursor(0, 0);
  lcd.print("Env Classifier");
  lcd.setCursor(0, 1);
  lcd.print("starting...");

  Serial.println("Environmental classifier started.");
}

void loop() {
  unsigned long now = millis();

  // DHT11 reads happen on their own slower timer, deliberately decoupled
  // from the sensor-sample/LCD-render cycle below. See the comment near
  // DHT_READ_INTERVAL_MS for why this separation matters. Returning
  // immediately after a DHT11 read -- rather than falling through to
  // the sensor/LCD code below in the same pass -- guarantees a DHT11
  // read and an LCD write never happen within the same loop() call,
  // not just "less often": two independent timers tripping in the same
  // iteration was still possible before this early return.
  if (now - lastDhtReadMs >= DHT_READ_INTERVAL_MS) {
    lastDhtReadMs = now;
    float dhtTemp = dht.readTemperature();
    float dhtHumidity = dht.readHumidity();
    // DHT11 reads occasionally fail and return NaN. Rather than let a
    // failed read corrupt the cached value, only overwrite the cache on
    // a successful read -- a momentary glitch then just means we keep
    // using the last known-good reading until the next attempt.
    if (!isnan(dhtTemp)) lastValidTemp = dhtTemp;
    if (!isnan(dhtHumidity)) lastValidHumidity = dhtHumidity;
    return;
  }

  if (now - lastSampleMs < SAMPLE_INTERVAL_MS) return;
  lastSampleMs = now;

  int thermistorRaw = analogRead(THERMISTOR_PIN);
  int photoRaw = analogRead(PHOTORESISTOR_PIN);

  EnvClass state = classify(
    (float)thermistorRaw,
    (float)photoRaw,
    lastValidTemp,
    lastValidHumidity
  );

  bool fanOn = shouldFanRun(state);
  digitalWrite(FAN_PIN, fanOn ? HIGH : LOW);

  renderLCD(state, fanOn, thermistorRaw, photoRaw, lastValidTemp);

  Serial.print("thermistor=");
  Serial.print(thermistorRaw);
  Serial.print(" photo=");
  Serial.print(photoRaw);
  Serial.print(" temp=");
  Serial.print(lastValidTemp);
  Serial.print(" humidity=");
  Serial.print(lastValidHumidity);
  Serial.print(" -> state=");
  Serial.print(classToString(state));
  Serial.print(" fan=");
  Serial.println(fanOn ? "ON" : "OFF");
}
